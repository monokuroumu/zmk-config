## config/boards/shields/dactylsygnus/Kconfig.defconfig
```kconfig
# Copyright (c) 2020 The ZMK Contributors
# SPDX-License-Identifier: MIT

if SHIELD_DACTYLSYGNUS_LEFT

config ZMK_KEYBOARD_NAME
	default "Dactyl Sygnus"

config ZMK_SPLIT_ROLE_CENTRAL
	default y

endif

if SHIELD_DACTYLSYGNUS_LEFT || SHIELD_DACTYLSYGNUS_RIGHT

config ZMK_SPLIT
	default y

endif
```

## config/boards/shields/dactylsygnus/Kconfig.shield
```kconfig
# Copyright (c) 2020 The ZMK Contributors
# SPDX-License-Identifier: MIT

config SHIELD_DACTYLSYGNUS_LEFT
	def_bool $(shields_list_contains,dactylsygnus_left)

config SHIELD_DACTYLSYGNUS_RIGHT
	def_bool $(shields_list_contains,dactylsygnus_right)
```
